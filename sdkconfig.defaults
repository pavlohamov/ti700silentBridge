## sdkconfig.defaults
```kconfig
CONFIG_TINYUSB_CDC_ENABLED=y
#CONFIG_TINYUSB_CDC_COUNT=2



CONFIG_COMPILER_OPTIMIZATION_SIZE=y
CONFIG_PARTITION_TABLE_CUSTOM=y
CONFIG_PARTITION_TABLE_CUSTOM_FILENAME="boards/${BOARD}/partition.csv"
CONFIG_FREERTOS_HZ=1000
CONFIG_FREERTOS_CORETIMER_1=y
CONFIG_FREERTOS_USE_TRACE_FACILITY=y
CONFIG_LWIP_TCPIP_TASK_STACK_SIZE=4096
CONFIG_LWIP_IRAM_OPTIMIZATION=y
CONFIG_ESP_MAIN_TASK_STACK_SIZE=12288
CONFIG_ESP_SYSTEM_EVENT_TASK_STACK_SIZE=3072
CONFIG_ESP_XT_WDT=y
CONFIG_PARTITION_TABLE_OFFSET=0xC000

CONFIG_PM_ENABLE=y

CONFIG_ADC_CONTINUOUS_ISR_IRAM_SAFE=y

CONFIG_SPIRAM_TRY_ALLOCATE_WIFI_LWIP=y
CONFIG_SPIRAM_ALLOW_BSS_SEG_EXTERNAL_MEMORY=y
CONFIG_SPIRAM_MALLOC_ALWAYSINTERNAL=0
# task's stacks are also here
CONFIG_SPIRAM_MALLOC_RESERVE_INTERNAL=98304

CONFIG_RTC_CLK_SRC_INT_RC=y
CONFIG_ESP_DEFAULT_CPU_FREQ_MHZ_240=y

CONFIG_ESP_WIFI_SLP_IRAM_OPT=y

#todo: put data into phy_init instaed of nvs
CONFIG_ESP_PHY_CALIBRATION_AND_DATA_STORAGE=n
CONFIG_ESP_PHY_INIT_DATA_IN_PARTITION=y
CONFIG_ESP_PHY_DEFAULT_INIT_IF_INVALID=y

CONFIG_ETH_USE_SPI_ETHERNET=n

CONFIG_HEAP_ABORT_WHEN_ALLOCATION_FAILS=y

CONFIG_MBEDTLS_TLS_CLIENT_ONLY=y
CONFIG_MBEDTLS_EXTERNAL_MEM_ALLOC=y
CONFIG_MBEDTLS_DYNAMIC_BUFFER=y
CONFIG_MBEDTLS_SSL_OUT_CONTENT_LEN=16384

CONFIG_BOOTLOADER_APP_ROLLBACK_ENABLE=y

CONFIG_APP_PROJECT_VER_FROM_CONFIG=y
CONFIG_APP_PROJECT_VER="${VERSION}"

CONFIG_TWAI_ISR_IN_IRAM=y
CONFIG_UART_ISR_IN_IRAM=y
CONFIG_SPI_MASTER_IN_IRAM=y
CONFIG_SPI_SLAVE_ISR_IN_IRAM=n

CONFIG_I2S_ISR_IRAM_SAFE=y

CONFIG_ESP_CONSOLE_USB_SERIAL_JTAG=y
#CONFIG_ESP_CONSOLE_UART_DEFAULT=y
#CONFIG_ESP_CONSOLE_USB_CDC=y
```
